## conf/distro/astertom.conf
```bitbake
require conf/distro/poky.conf      
DISTRO = "astertom"
DISTRO_NAME = "AsterTom Distro"      
DISTRO_VERSION = "1.0"      
DISTRO_CODENAME = "astertom"      
DISTRO_FEATURES += "usbhost systemd ipv6 keyboard touchscreen"
DISTRO_FEATURES_BACKFILL_CONSIDERED += "sysvinit"
VIRTUAL-RUNTIME_login_manager = "shadow-base"
VIRTUAL-RUNTIME_init_manager = "systemd"
VIRTUAL-RUNTIME_initscripts = "systemd-compat-units"
SDK_VENDOR = "-astertomsdk"
SDK_VERSION := "${@'${DISTRO_VERSION}'.replace('snapshot-${DATE}','snapshot')}"      
MAINTAINER = "developers@astertom.pl"      
INHERIT += "buildhistory"      
BUILDHISTORY_COMMIT = "1"
TARGET_VENDOR = "-astertom"
SDKPATH = "/usr/local/AsterTom/astertom_${MACHINE}_sdk"
```

## conf/layer.conf
```bitbake
# We have a conf and classes directory, add to BBPATH
BBPATH .= ":${LAYERDIR}:${LAYERDIR}/common:${LAYERDIR}/conf/include"

# We have recipes-* directories, add to BBFILES
BBFILES += " \
    ${LAYERDIR}/recipes-*/*/*.bb \
    ${LAYERDIR}/recipes-*/*/*.bbappend \
    ${LAYERDIR}/recipes-*/*.bb \
    ${LAYERDIR}/recipes-*/*.bbappend \
"
BBFILES_DYNAMIC += " \
    raspberrypi:${LAYERDIR}/dynamic-layers/meta-raspberrypi/recipes-*/*/*.bb \
    raspberrypi:${LAYERDIR}/dynamic-layers/meta-raspberrypi/recipes-*/*/*.bbappend \
    raspberrypi:${LAYERDIR}/dynamic-layers/meta-raspberrypi/recipes-*/*.bb \
    raspberrypi:${LAYERDIR}/dynamic-layers/meta-raspberrypi/recipes-*/*.bbappend \
    mender:${LAYERDIR}/dynamic-layers/meta-mender-core/recipes-*/*/*.bb \
    mender:${LAYERDIR}/dynamic-layers/meta-mender-core/recipes-*/*/*.bbappend \
    mender:${LAYERDIR}/dynamic-layers/meta-mender-core/recipes-*/*.bb \
    mender:${LAYERDIR}/dynamic-layers/meta-mender-core/recipes-*/*.bbappend \
"
                                                                                                                               
BBFILE_COLLECTIONS += ""
BBFILE_PRIORITY_astertom = "5"

# Additional license directories.
LICENSE_PATH += "${LAYERDIR}/licenses"

LAYERDEPENDS_astertom = "oe poky"
LAYERRECOMMENDS_astertom = ""

LAYERVERSION_astertom = "1"
LAYERSERIES_COMPAT_astertom = "kirstone"


require ${LAYERDIR}/conf/include/maintainers.inc
```
